## conf/layer.conf
```bitbake
# We have a conf and classes directory, add to BBPATH
BBPATH .= ":${LAYERDIR}"

# We have recipes-* directories, add to BBFILES
BBFILES += "${LAYERDIR}/recipes-*/*/*.bb \
            ${LAYERDIR}/recipes-*/*/*.bbappend"

BBFILE_COLLECTIONS += "meta-codeemsys"
BBFILE_PATTERN_meta-codeemsys = "^${LAYERDIR}/"
BBFILE_PRIORITY_meta-codeemsys = "6"

LAYERDEPENDS_meta-codeemsys = "core"
LAYERSERIES_COMPAT_meta-codeemsys = "kirkstone"
```
